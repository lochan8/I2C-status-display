// SPDX-License-Identifier: (GPL-2.0+ OR MIT)
/*
 * Copyright (c) 2023 Edgeble AI Technologies Pvt. Ltd.
 */

/dts-v1/;

#include "rk3588.dtsi"
#include "rk3588-edgeble-neu6b.dtsi"

/ {
	model = "[Linux-6.1] Edgeble NCM6A-HDMI1-CAM0-CAM1";
	compatible = "edgeble,neural-compute-module-6a-io", "rockchip,rk3588";
};

#include "rk3588-edgeble-neu6b-io-hdmi1.dtsi"
#include "rk3588-edgeble-neu6b-cam0.dtsi"
#include "rk3588-edgeble-neu6b-cam1.dtsi"
