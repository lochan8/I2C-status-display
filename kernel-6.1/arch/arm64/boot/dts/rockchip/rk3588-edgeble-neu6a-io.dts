// SPDX-License-Identifier: (GPL-2.0+ OR MIT)
/*
 * Copyright (c) 2023 Edgeble AI Technologies Pvt. Ltd.
 */

/dts-v1/;

#include "rk3588.dtsi"
#include "rk3588-edgeble-neu6b.dtsi"

/ {
	model = "Edgeble-6A Commercial";
	compatible = "edgeble,neural-compute-module-6a-io", "rockchip,rk3588";
};
